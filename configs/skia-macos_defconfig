## configs/skia-macos_defconfig
```kconfig
CONFIG_RECIPE:=skia
CONFIG_VARIANT:=macos
CLANG:=clang
CLANGXX:=clang++
CC:=clang
SKIA_ARCH:=x64

CONFIG_SYSROOT:=y
CONFIG_SKIACONFIG:=macos
```

## configs/skia-wasm_defconfig
```kconfig
CONFIG_RECIPE:=skia
CONFIG_VARIANT:=wasm

CONFIG_SYSROOT:=y
CONFIG_SKIACONFIG:=wasm
CONFIG_SKIA_EMBEDDED_FONTS:=y

DOCKER_SERVICE:=skiabuild-wasm

SKIA_CC:=emcc
SKIA_CXX:=em++
SKIA_AR:=emar

GN:=./bin/gn
```

## configs/skia-win_x64_defconfig
```kconfig
CONFIG_RECIPE:=skia
CONFIG_VARIANT:=win_x64
CLANG:=clang
CLANGXX:=clang++
CC:=clang
SKIA_ARCH:=x64

CONFIG_SKIACONFIG:=windows
```

## configs/skia_defconfig
```kconfig
CONFIG_RECIPE:=skia
CONFIG_MESON:=y
CONFIG_FREETYPE:=y
CONFIG_FONTCONFIG:=y
CONFIG_AVALONIA_SKIA:=y
CONFIG_SYSROOT:=y

CONFIG_SKIACONFIG:=linux
```
